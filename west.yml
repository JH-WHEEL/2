## west.yml
```yaml
# ZMK 官方 west.yml（main 分支）
manifest:
  remotes:
    - name: zmkfirmware
      url-base: https://github.com/zmkfirmware
    - name: zephyrproject
      url-base: https://github.com/zephyrproject-rtos
    - name: nordic
      url-base: https://github.com/nrfconnect
    - name: tinyusb
      url-base: https://github.com/hathach
    - name: lvgl
      url-base: https://github.com/lvgl

  projects:
    - name: zephyr
      remote: zephyrproject
      revision: main
      import:
        file: west.yml
        path-prefix: modules

    - name: zmk
      remote: zmkfirmware
      revision: main
      path: zmk
      import: true

    - name: nrfxlib
      remote: nordic
      revision: main
      path: modules/lib/nrfxlib

    - name: tinyusb
      remote: tinyusb
      revision: master
      path: modules/third_party/tinyusb

    - name: lvgl
      remote: lvgl
      revision: release/v8.3
      path: modules/third_party/lvgl

  self:
    path: zmk
```
